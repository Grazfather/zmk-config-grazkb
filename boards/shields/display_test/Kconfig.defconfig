## boards/shields/display_test/Kconfig.defconfig
```kconfig
if SHIELD_DISPLAY_TEST

config ZMK_KEYBOARD_NAME
    default "display_test"

endif
```

## boards/shields/display_test/Kconfig.shield
```kconfig
config SHIELD_DISPLAY_TEST
    def_bool $(shields_list_contains,display_test)

config LV_Z_BITS_PER_PIXEL
    default 1

choice LV_COLOR_DEPTH
    default LV_COLOR_DEPTH_1
endchoice
```
